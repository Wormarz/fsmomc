## Kconfig
```kconfig
mainmenu "FSMOMC Configuration"

config MAX_SM_NAME_LEN
    int "Maximum length of state machine name"
    range 0 32
    default 16

config MAX_SM_EDGES_NUMS
    int "Maximum number of edges that a state support"
    range 0 32
    default 4
```
